/*
 * Copyright (c) 2021, 2023 Nordic Semiconductor ASA
 *
 * SPDX-License-Identifier: Apache-2.0
 */

/ {
	chosen {
		zephyr,console = &snippet_cdc_acm_console_uart;
		zephyr,shell-uart = &snippet_cdc_acm_console_uart;
	};
};

/*
 * This nodelabel is consumed by the
 */
zephyr_cdc_acm_console: &zephyr_udc1 {
	snippet_cdc_acm_console_uart: snippet_cdc_acm_console_uart {
		compatible = "zephyr,cdc-acm-uart";
		label = "Console ACM";
	};
};
