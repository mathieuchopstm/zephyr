## dts/bindings/clock-management/stm32/st,stm32-timer-freqmul.yaml
```yaml
# Copyright 2025 STMicroelectronics
# SPDX-License-Identifier: Apache-2.0

description: STM32 timer frequency multiplier

compatible: "st,stm32-timer-freqmul"

include: [clock-node.yaml]

properties:
  apbpre-loc:
    required: true
    type: array
    description: |
      APBPRE field corresponding to the bus on
      which this frequency multiplier is connected

      Three elements:
        [0]: RCC register address
        [1]: offset of configuration field
        [2]: size of configuration field

  timpre-loc:
    type: array
    description: |
      TIMPRE field in RCC

      Three elements:
        [0]: RCC register address
        [1]: offset of configuration field
        [2]: size of configuration field

      If this property is absent, a fixed 2x multiplication factor is assumed.
      If this property is present, the behavior depends on field size:
        - 1 bit: 2x if TIMPRE=0b0, 4x if TIMPRE=0b1
        - 2 bit: (to be supported)

  "#clock-cells":
    const: 0
```

## dts/bindings/clock-management/stm32/st,stm32c0-hsisys-div.yaml
```yaml
# Copyright (c) 2025, STMicroelectronics
# SPDX-License-Identifier: Apache-2.0

description: STM32C0 HSISYS prescaler

compatible: "st,stm32c0-hsisys-div"

include: [clock-node.yaml]

properties:
  reg-and-field:
    required: true
    type: array
    description: |
      Three elements:
        [0]: RCC register address
        [1]: offset of configuration field
        [2]: size of configuration field

  "#clock-cells":
    const: 1

clock-cells:
  # must be in register format
  - prescaler
```

## dts/bindings/clock-management/zephyr,cms-init-order.yaml
```yaml
# Copyright 2025 STMicroelectronics
# SPDX-License-Identifier: Apache-2.0

description: "Ordered initialization node for Zephyr's Clock Management Subsystem"

compatible: "zephyr,cms-init-order"

properties:
  "nodes":
    type: phandles
    description: tbd
```

## dts/bindings/mdio/st,stm32-ethernet-mdio.yaml
```yaml
# Copyright (c) 2025 STMicroelectronics
# SPDX-License-Identifier: Apache-2.0

description: STM32 MDIO controller (built into Ethernet IP)

compatible: "st,stm32-ethernet-mdio"

include: [mdio-controller.yaml, pinctrl-device.yaml]

properties:
  "#address-cells":
    required: true
    const: 1

  "#size-cells":
    required: true
    const: 0

  clocks:
    required: true

  pinctrl-0:
    required: true

  pinctrl-names:
    required: true
```

## dts/bindings/phy/st,stm32-embedded-otghs-phy.yaml
```yaml
# Copyright (c) 2025 STMicroelectronics
# SPDX-License-Identifier: Apache-2.0

title: STM32 embedded High-Speed USB PHY for OTG_HS

description: |
  Embedded High-Speed USB PHY connected to OTG_HS peripheral over UTMI+.

  Found on all series which have an OTG_HS instance with embedded PHY when
  the PHY is not the ST "USBPHYC" covered by "st,stm32-usbphyc" binding.

compatible: "st,stm32-embedded-otghs-phy"

include: phy-controller.yaml

properties:
  "#phy-cells":
    const: 0

  clocks:
    required: true
    description: |
      HS PHY clock configuration

      This is an array of two cells:
        - the first indicates the RCC bit enabling the PHY's clock
        - the second indicates the PHY clock mux configuration

      For example, on STM32H7R/S series:
        /*
         * RCC_AHB1ENR bit 26 = USBPHYCEN
         * RCC_CCIPR1 [13:12] = USBPHYCSEL
         */

        /* hse_ker_ck */
        clocks = <&rcc STM32_CLOCK(AHB1, 26)>,
                 <&rcc STM32_SRC_HSE USBPHYC_SEL(0)>;

        /* (hse_ker_ck / 2) */
        clocks = <&rcc STM32_CLOCK(AHB1, 26)>,
                 <&rcc (STM32_SRC_HSE | STM32_CLOCK_DIV(2)) USBPHYC_SEL(1)>;

        /* pll3_q_ck */
        clocks = <&rcc STM32_CLOCK(AHB1, 26)>,
                 <&rcc STM32_SRC_HSE USBPHYC_SEL(0)>;

  input-frequency:
    type: string
    required: true
    enum:
      - "16M"
      - "19.2M"
      - "20M"
      - "24M"
      - "26M"
      - "32M"
    description: |
      HS PHY input clock frequency (in Hz)

      This should be determined based on the system's clock configuration.
      For example, if the PHY input clock is 16 MHz, use value "16M".
```

## dts/bindings/sensor/st,stm32-temp-common.yaml
```yaml
# Copyright (c) 2022, Wouter Cappelle
# SPDX-License-Identifier: Apache-2.0

include: sensor-device.yaml

properties:
  io-channels:
    required: true
    description: ADC channel for temperature sensor

  ntc:
    type: boolean
    description: |
      Negative Temperature Coefficient - sensor value decreases as Tjunction increases.

      This is visible in the formula used for temperature calculation, which has the
      form "Calibration_Value - ADC_Value" rather than "ADC_Value - Calibration_Value".

      True on STM32F1 and STM32F2 series ("V25 - Vsense").
      True on STM32F030 and STM32F070 lines ("TS_CAL1 - Sense_DATA").
```

## dts/bindings/sensor/st,stm32-temp.yaml
```yaml
# Copyright (c) 2021, Eug Krashtan
# SPDX-License-Identifier: Apache-2.0

description: STM32 family TEMP node

compatible: "st,stm32-temp"

include: [base.yaml, "st,stm32-temp-common.yaml"]

properties:
  avgslope:
    type: string
    required: true
    description: |
      Average slope of T-V chart (in mV/°C), found in MCU datasheet
      chapters "Electrical characteristics" or "Operating conditions"

      For STM32F1 series:
        - Typical value of 4.3 mV/°C (min 4.0; max 4.6) for most lines
          - STM32F100x4 / STM32F100x6 / STM32F100x8 / STM32F100xB (DS6517 Table 5.3.19)
          - STM32F100xC / STM32F100xD / STM32F100xE (DS5944 Table 5.3.20)
          - STM32F101x4 / STM32F101x6 (DS5935 Table 5.3.18)
          - STM32F101x8 / STM32F101xB (DS5318 Table 5.3.18)
          - STM32F101xC / STM32F101xD / STM32F101xE (DS5791 Table 5.3.20)
          - STM32F101xF / STM32F101xG (DS6557 Table 5.3.20)
          - STM32F103x4 / STM32F103x6 (DS5936 Table 5.3.19)
          - STM32F103x8 / STM32F103xB (DS5319 Table 5.3.19)
          - STM32F103xC / STM32F103xD / STM32F103xE (DS5792 Table 5.3.21)
          - STM32F103xF / STM32F103xG (DS6558 Table 5.3.21)
          - STM32F105xx / STM32F107xx (DS6014 Table 5.3.19)

          - Typical value of 4.35 mV/°C (no min/max) for STM32F102 line
            - STM32F102x4 / STM32F102x6 (DS5934 Table 5.3.18)
            - STM32F102x8 / STM32F102xB (DS5933 Table 5.3.18)

      For STM32F2 series: typical value of 2.5 mV/°C
        - STM32F20xxx (DS6329 Table 6.3.22)
        - STM32F215xx / STM32217xx (DS6697 Table 6.3.22)

  v25:
    type: int
    required: true
    description: |
      Voltage of temperature sensor at 25°C (in mV), found in MCU datasheet
      chapters "Electrical characteristics" or "Operating conditions"

      For STM32F1 series:
        - Typical value of 1.43 V (min 1.34; max 1.52) for most lines
          - STM32F101x4 / STM32F101x6 (DS5935 Table 5.3.18)
          - STM32F101x8 / STM32F101xB (DS5318 Table 5.3.18)
          - STM32F101xC / STM32F101xD / STM32F101xE (DS5791 Table 5.3.20)
          - STM32F101xF / STM32F101xG (DS6557 Table 5.3.20)
          - STM32F103x4 / STM32F103x6 (DS5936 Table 5.3.19)
          - STM32F103x8 / STM32F103xB (DS5319 Table 5.3.19)
          - STM32F103xC / STM32F103xD / STM32F103xE (DS5792 Table 5.3.21)
          - STM32F103xF / STM32F103xG (DS6558 Table 5.3.21)
          - STM32F105xx / STM32F107xx (DS6014 Table 5.3.19)

        - Typical value of 1.41 V (min 1.32; max 1.50) for STM32F100 line
          - STM32F100x4 / STM32F100x6 / STM32F100x8 / STM32F100xB (DS6517 Table 5.3.19)
          - STM32F100xC / STM32F100xD / STM32F100xE (DS5944 Table 5.3.20)

        - Typical value of 1.42 V (no min/max) for STM32F102 line
          - STM32F102x4 / STM32F102x6 (DS5934 Table 5.3.18)
          - STM32F102x8 / STM32F102xB (DS5933 Table 5.3.18)

      For STM32F2 series: typical value of 0.76 V (760 mV)
        - STM32F20xxx (DS6329 Table 6.3.22)
        - STM32F215xx / STM32217xx (DS6697 Table 6.3.22)
```

## dts/bindings/sensor/st,stm32c0-temp-cal.yaml
```yaml
# Copyright (c) 2023, Benjamin Björnsson <benjamin.bjornsson@gmail.com>
# SPDX-License-Identifier: Apache-2.0

description: |
    STM32 family TEMP node for production calibrated sensors with a single calibration temperature.

compatible: "st,stm32c0-temp-cal"

include: "st,stm32-temp-cal-common.yaml"

properties:
  avgslope:
    type: string
    required: true
    description: |
      Average slope of T-V chart (in mV/°C), found in MCU datasheet
      chapters "Electrical characteristics" or "Operating conditions"
      (multiply datasheet value by 1000 to convert from mV/°C to µV/°C)

      For STM32C0 series: typical value of 2.53 mV/°C (min 2.4; max 2.65)
        - STM32C011x4 / STM32C011x6 (DS13866 Table 5.3.16)
        - STM32C031x4 / STM32C031x6 (DS13867 Table 5.3.16)

      For STM32F030/STM32F070 lines: typical value of 4.3 mV/°C,
         minimum value of 4.0 mV/°C, maximum value of 4.6 mV/°C
        - STM32F030xx (DS9773 Table 6.3.17)
        - STM32F070xx (DS10697 Table 6.3.17)
```

## dts/bindings/serial/st,stm32-usart.yaml
```yaml
description: STM32 USART

compatible: "st,stm32-usart"

include: [clock-device.yaml, "st,stm32-uart-base.yaml"]
```

## soc/st/stm32/Kconfig
```kconfig
# Copyright (c) 2024 STMicroelectronics
# SPDX-License-Identifier: Apache-2.0

config SOC_FAMILY_STM32
	select HAS_SEGGER_RTT if ZEPHYR_SEGGER_MODULE
	select STM32_ENABLE_DEBUG_SLEEP_STOP if DEBUG || ZTEST
	select BUILD_OUTPUT_HEX

if SOC_FAMILY_STM32

rsource "*/Kconfig"

# Code shared between all families goes in "common/" and is
# configured by Kconfig symbols declared in "common/Kconfig".
#
# There are however some Kconfig symbols shared by all series
# but not consumed by the shared code; instead, SoC-specific
# code, certain drivers or the STM32Cube HAL module will make
# use of these symbols.  Such symbols should be declared in
# this file rather than "common/Kconfig".

config USE_STM32_ASSERT
	depends on ASSERT
	bool "STM32Cube HAL and LL drivers asserts"
	help
	  Enable asserts in STM32Cube HAL and LL drivers.

config HAS_STM32_FLASH_PREFETCH
	bool
	help
	  Hidden symbol selected by SoCs which support flash prefetch.

config STM32_FLASH_PREFETCH
	bool "Flash prefetch buffer"
	default y
	depends on HAS_STM32_FLASH_PREFETCH
	help
	  Enable flash prefetch. For power efficiency, it is recommended to
	  be enabled when flash is accessed through a cache memory. Flash
	  prefetch also improves performances a bit.

choice POWER_SUPPLY_CHOICE
	prompt "STM32 power supply configuration"
	default POWER_SUPPLY_LDO
	depends on SOC_SERIES_STM32H7X || SOC_SERIES_STM32H7RSX || \
		SOC_SERIES_STM32U5X || SOC_STM32WBA55XX || SOC_STM32WBA65XX

config POWER_SUPPLY_LDO
	bool "LDO supply"

config POWER_SUPPLY_DIRECT_SMPS
	bool "Direct SMPS supply"

config POWER_SUPPLY_SMPS_1V8_SUPPLIES_LDO
	bool "SMPS 1.8V supplies LDO (no external supply)"
	depends on SOC_SERIES_STM32H7X || SOC_SERIES_STM32H7RSX

config POWER_SUPPLY_SMPS_2V5_SUPPLIES_LDO
	bool "SMPS 2.5V supplies LDO (no external supply)"
	depends on SOC_SERIES_STM32H7X || SOC_SERIES_STM32H7RSX

config POWER_SUPPLY_SMPS_1V8_SUPPLIES_EXT_AND_LDO
	bool "External SMPS 1.8V supply, supplies LDO"
	depends on SOC_SERIES_STM32H7X || SOC_SERIES_STM32H7RSX

config POWER_SUPPLY_SMPS_2V5_SUPPLIES_EXT_AND_LDO
	bool "External SMPS 2.5V supply, supplies LDO"
	depends on SOC_SERIES_STM32H7X || SOC_SERIES_STM32H7RSX

config POWER_SUPPLY_SMPS_1V8_SUPPLIES_EXT
	bool "External SMPS 1.8V supply and bypass"
	depends on SOC_SERIES_STM32H7X || SOC_SERIES_STM32H7RSX

config POWER_SUPPLY_SMPS_2V5_SUPPLIES_EXT
	bool "External SMPS 2.5V supply and bypass"
	depends on SOC_SERIES_STM32H7X || SOC_SERIES_STM32H7RSX

config POWER_SUPPLY_EXTERNAL_SOURCE
	bool "Bypass"
	depends on SOC_SERIES_STM32H7X || SOC_SERIES_STM32H7RSX

endchoice

config STM32_APP_IN_EXT_FLASH
	bool
	help
	  Allows the SoC clock driver to correctly initialize the
	  Q/O/XSPI controller clocks when the application is residing
	  in external Flash and is chainloaded with MCUboot.
	  Whether the app is eXecuted in Place (XiP) depends on the MCUboot mode used.

endif # SOC_FAMILY_STM32
```
