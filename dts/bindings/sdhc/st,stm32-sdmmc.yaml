## dts/bindings/sdhc/st,stm32-sdmmc.yaml
```yaml
# SPDX-FileCopyrightText: Copyright The Zephyr Project Contributors
# SPDX-License-Identifier: Apache-2.0

title: STM32 SDMMC Host Controller

description: |
  STM32 Host Controller for SD/SDIO/MMC/eMMC with internal DMA controller.

compatible: "st,stm32-sdmmc"

include: [sdhc.yaml, pinctrl-device.yaml, reset-device.yaml]

properties:
  disk-name:
    type: string
    description: |
      Disk name (legacy disk driver usage).

  clocks:
    required: true

  reg:
    required: true

  resets:
    required: true

  pinctrl-0:
    required: true

  pinctrl-names:
    required: true

  cd-gpios:
    type: phandle-array
    description: Card Detect pin

  pwr-gpios:
    type: phandle-array
    description: Power pin

  bus-width:
    type: int
    default: 1
    description: |
      Bus width for SDMMC access.

      Defaults to the minimum necessary number of bus lines.
    enum: [1, 4, 8]

  clk-div:
    type: int
    default: 0
    description: |
      Clock division factor for SDMMC. The relationship between this value
      and the output bus frequency is FREQ_BUS = SDMMMC_CLK / [CLKDIV + 2].
      Therefore an input clock of 25MHz and a division factor of 0 would
      result in a bus frequency of 25MHz / [0 + 2] = 12.5MHz.

  clk-bypass:
    type: boolean
    description: |
      Bypass the clock divider configured in `clk-div`, which results in the
      output bus frequency matching the input SDMMC_CLK. Not supported on
      all part numbers.

  idma:
    type: boolean
    description: |
      SDMMC device has an internal DMA.
      Delete this property to use interrupt driven mode.

  hw-flow-control:
    type: boolean
    description: Set to enable RTS/CTS flow control at boot time

  support-1-8-v:
    type: boolean
    description: |
        When defined, it indicates that the external SDIO circuit supports 1.8V signaling.
```

## dts/bindings/sensor/st,stm32wb0-temp-cal.yaml
```yaml
# Copyright (c) 2024 STMicroelectronics
# SPDX-License-Identifier: Apache-2.0

description: |
    STM32 family TEMP node for production calibrated sensors like STM32WB0,
    which have a sensor value and a chuck temperature.

compatible: "st,stm32wb0-temp-cal"

include:
  - name: st,stm32-temp-cal-common.yaml
    property-blocklist:
      - ts-cal1-temp

properties:
  nvmem-cell-names:
    description: |
      Two NVMEM cells must be provided: C30 and TCK

      These cells correspond to the eponymous calibration parameters.
    enum: ["C30", "TCK"]
    min-len: 2
    max-len: 2
```

## samples/subsys/usb/uac2_explicit_feedback/boards/stm32h573i_dk.conf
```kconfig
CONFIG_LOG=y
CONFIG_LOG_BUFFER_SIZE=131072

# bump up things that could cause OOM
CONFIG_HEAP_MEM_POOL_SIZE=65536
CONFIG_UDC_STM32_STACK_SIZE=2048
CONFIG_I2S_STM32_SAI_BLOCK_COUNT=64

# enable isochronous support
CONFIG_UDC_STM32_STUSB_ISO_OUT_EP_NUM=1
CONFIG_UDC_STM32_STUSB_ISO_IN_EP_NUM=1
```
