## dts/bindings/clock-management/stm32/pll/st,stm32-h7-pll-pvco.yaml
~~~~yaml
# Copyright 2025 STMicroelectronics
# SPDX-License-Identifier: Apache-2.0

description: |
  STM32H7 PLL prescaler and VCO

  ```
           Shared PLL source clock
                     |
   +=================|=================+
   | PLLx            V                 |
   |  prescaler  [/ DIVMx]             |
   |  stage          | = refx_ck       |
   | _______________ | _______________ |
   | PLLx            |                 |
   |  VCO stage      V                 |
   |           [* mulfactor]           |
   |                 | = vcox_ck       |
   | _______________ | _______________ |
   | PLLx            |                 |
   |  output stage   |                 |
   |                 |                 |
   |     +-----------+-----------+     |
   |     |           |           |     |
   |     V           V           V     |
   | [/ DIVPx]   [/ DIVQx]   [/ DIVRx] |
   |     |           |           |     |
   |  G -x           |           |     |
   |  A  |           |           |     |
   |  T -|-----------x           |     |
   |  E  |           |           |     |
   |  S -|-----------|-----------x     |
   |     |           |           |     |
   +=====|===========|===========|=====+
         |           |           |
         V           V           V
     pllx_p_ck   pllx_q_ck   pllx_r_ck
  ```

  The value of mulfactor is:
    - (DIVNx) if fractional mode is disabled
    - (DIVNx + (FRACNx / 2^13)) if fractional mode is enabled

  This binding describes properties for the prescaler and VCO
  stages of a PLL. These two stages are merged into a single
  node which hosts each output as a separate child node.

  See st,stm32-h7-pll-output for more details about outputs.

  In a more practical example:
    pll1-pvco {
      /* DIVMx and VCO properties */

      pll1-p { /* P output properties */ };
      pll1-q { /* Q output properties */ };
      pll1-r { /* R output properties */ };
    };

  The "reg-XXX" properties are expected to
  be an array of three elements:
    [0]: RCC register address
    [1]: offset of configuration field
    [2]: size of configuration field (defaults to 1 if not present)

compatible: "st,stm32-h7-pll-pvco"

include: [clock-node.yaml]

properties:
  reg-divm:
    required: true
    type: array
    description: PLL DIVMx field location

  reg-on:
    required: true
    type: array
    description: PLLxON bit location

  reg-rdy:
    required: true
    type: array
    description: PLLxRDY bit location

  reg-vcosel:
    required: true
    type: array
    description: PLLxVCOSEL bit location

  reg-range:
    required: true
    type: array
    description: PLLxRGE field location

  reg-fracen:
    required: true
    type: array
    description: PLLxFRACEN bit location

  reg-divn:
    required: true
    type: array
    description: PLL DIVNx field location

  reg-fracn:
    required: true
    type: array
    description: PLL FRACNx field location

  "#clock-cells":
    const: 5

# static configuration
  divm:
    type: int

  vcosel:
    type: int

  range:
    type: int

  divn:
    type: int

  fracn:
    type: int
    description: |
      If non-zero, fractional mode is enabled
      and FRACN is set to this property's value.
      If zero, fractional mode is disabled.

clock-cells:
  - divm
  - vcosel
  - range
  - divn
  - fracn
~~~~

## dts/bindings/clock-management/stm32/st,stm32-bus-prescaler.yaml
```yaml
# Copyright 2025 STMicroelectronics
# SPDX-License-Identifier: Apache-2.0

description: STM32 bus clock prescaler

compatible: "st,stm32-bus-prescaler"

include: [clock-node.yaml]

properties:
  reg-and-field:
    required: true
    type: array
    description: |
      Three elements:
        [0]: RCC register address
        [1]: offset of configuration field
        [2]: size of configuration field

  ahbpre:
    type: boolean
    description: True on AHB prescaler. False otherwise.

  "#clock-cells":
    const: 1

# static configuration
  prescaler:
    type: int
    description: Prescaler value (in register format) for static configuration

clock-cells:
  # must be in register format
  - prescaler
```

## dts/bindings/clock-management/stm32/st,stm32-clkgen-common.yaml
```yaml
# Copyright 2025 STMicroelectronics
# SPDX-License-Identifier: Apache-2.0

description: |
  Common properties shared by STM32 clock generators.

  This notably includes a register that contains an "enable" bit and
  a "status" bit for that generator.

  #clock-cells is left undefined to allow upper bindings to define it.

compatible: "st,stm32-clock-generator"

include: [clock-node.yaml]

properties:
  rcc-reg:
    type: int
    required: true
    description: Address of the control register in RCC

  enable-offset:
    type: int
    required: true
    description: Offset of "generator enable" bit in register

  status-offset:
    type: int
    required: true
    description: Offset of "generator is enabled" bit in register

  clock-frequency:
    type: int
    required: true

# static configuration
  enable:
    type: boolean
    description: Enable generator during static init
```

## dts/bindings/clock-management/stm32/st,stm32-clock-gate.yaml
```yaml
# Copyright 2025 STMicroelectronics
# SPDX-License-Identifier: Apache-2.0

description: STM32 clock gate

compatible: "st,stm32-clock-gate"

include: [clock-node.yaml]

properties:
  reg-and-field:
    required: true
    type: array
    description: |
      Location of the field controlling this clock node in RCC.

      Two elements:
        [0]: RCC register address
        [1]: offset of configuration field

  "#clock-cells":
    const: 1

clock-cells:
  - enable
```

## dts/bindings/clock-management/stm32/st,stm32-clock-generator.yaml
```yaml
# Copyright 2025 STMicroelectronics
# SPDX-License-Identifier: Apache-2.0

description: |
  STM32 internal clock generator

  This can be HSI, LSI, or any other generator that has only an "enable" and "status" bit.

  NOTE: both bits must be in the same register.

compatible: "st,stm32-clock-generator"

include: [clock-node.yaml]

properties:
  rcc-reg:
    type: int
    required: true
    description: Address of the control register in RCC

  enable-offset:
    type: int
    required: true
    description: Offset of "generator enable" bit in register

  status-offset:
    type: int
    required: true
    description: Offset of "generator is enabled" bit in register

  clock-frequency:
    type: int
    required: true

  "#clock-cells":
    const: 1

clock-cells:
  - enable
```

## dts/bindings/clock-management/stm32/st,stm32-clock-multiplexer.yaml
```yaml
# Copyright 2025 STMicroelectronics
# SPDX-License-Identifier: Apache-2.0

description: STM32 clock multiplexer

compatible: "st,stm32-clock-multiplexer"

include: [clock-node.yaml]

properties:
  reg-and-field:
    required: true
    type: array
    description: |
      Three elements:
        [0]: RCC register address
        [1]: offset of configuration field
        [2]: size of configuration field

  inputs:
    type: phandles
    required: true
    description: |
      Multiplexer inputs

      The index in this array corresponds to the value that must be programmed
      in the mux register field to select the source found at that index.

      For example, with `inputs = <&clk_a &no_clock &clk_b &clk_c>;`:
        * a value of 0 selects `clk_a`
        * a value of 1 selects no clock
        * a value of 2 selects `clk_b`
        * a value of 3 selects `clk_c`

  "#clock-cells":
    const: 1

clock-cells:
  - input_selection
```

## dts/bindings/clock-management/stm32/st,stm32-hse.yaml
```yaml
# Copyright (c) 2025, STMicroelectronics
# SPDX-License-Identifier: Apache-2.0

description: STM32 HSE clock generator

compatible: "st,stm32-hse"

include: "st,stm32-clkgen-common.yaml"

# TODO: CSS (should be configured via Kconfig?)

properties:
  "#clock-cells":
    const: 2

  bypass-offset:
    type: int
    required: true
    description: Offset of "bypass mode enable" bit in register

clock-cells:
  - enable  # disable/enable generator
  - bypass  # disable/enable bypass mode
```

## dts/bindings/clock-management/stm32/st,stm32-internal-clkgen.yaml
```yaml
# Copyright (c) 2025, STMicroelectronics
# SPDX-License-Identifier: Apache-2.0

description: |
  STM32 internal oscillator generator

  This compatible can be used directly for STM32 clock
  generators with fixed frequency and no configuration
  (e.g., HSI or LSI). The driver also supports HSE and
  LSE, but these sources should have their own compatible
  in first position, in addition to this one.

compatible: "st,stm32-internal-clkgen"

include: "st,stm32-clkgen-common.yaml"

properties:
  "#clock-cells":
    const: 1

clock-cells:
  - enable  # disable/enable generator
```

## dts/bindings/clock-management/stm32/st,stm32-lse.yaml
```yaml
# Copyright (c) 2025, STMicroelectronics
# SPDX-License-Identifier: Apache-2.0

description: STM32 LSE clock generator

compatible: "st,stm32-lse"

include: "st,stm32-clkgen-common.yaml"

# TODO: LSECSS (should be configured via Kconfig?)

properties:
  "#clock-cells":
    const: 3

  bypass-offset:
    type: int
    required: true
    description: Offset of "bypass mode enable" bit in register

  drive-capability-field:
    type: array
    required: true
    description: |
      LSE driving capability register field

      [0]: offset to field in register
      [1]: size of field in register

# static configuration
  bypass:
    type: boolean
    description: Enable bypass mode during static init

  driving-capability:
    type: int
    description: Select driving capability to use during static init

clock-cells:
  - enable              # disable/enable generator
  - bypass              # disable/enable bypass mode
  - driving_capability  # external crystal driving capability
```

## dts/bindings/clock-management/stm32/st,stm32-sysclk-prescaler.yaml
```yaml
# Copyright 2025 STMicroelectronics
# SPDX-License-Identifier: Apache-2.0

description: STM32 SYSCLK prescaler

compatible: "st,stm32-sysclk-prescaler"

include: [clock-node.yaml]

properties:
  reg:
    required: true
    description: |
      Address cell: Offset of register in RCC
      Size cell: size of configuration field (number of bits)

  field-offset:
    type: int
    required: true
    description: |
      Offset of the configuration field in RCC register (LSB index)

  "#clock-cells":
    const: 1

clock-cells:
  - prescaler
```
