## boards/st/nucleo_c071rb/board.yml
```yaml
board:
  name: nucleo_c071rb
  full_name: Nucleo C071RB
  vendor: st
  revision:
    format: letter
    default: "O"
    exact: true
    revisions:
      # "V"anilla (no Clock Management)
      - name: "V"
      # "O"ptimized (using STM32-specific drivers for everything)
      - name: "O"
      # "G"eneric (using generic drivers when available, e.g., gate/mux)
      - name: "G"
  socs:
    - name: stm32c071xx
```

## boards/st/nucleo_c071rb/nucleo_c071rb_stm32c071xx_L_defconfig
```kconfig
# Disable clock control
CONFIG_CLOCK_CONTROL=n

# Enable clock management
CONFIG_CLOCK_MANAGEMENT=y

# Enable Off/On support
CONFIG_CLOCK_MANAGEMENT_OFF_ON_SUPPORT=y
```

## boards/st/nucleo_c071rb/nucleo_c071rb_stm32c071xx_O_defconfig
```kconfig
# Disable clock control
CONFIG_CLOCK_CONTROL=n

# Enable clock management
CONFIG_CLOCK_MANAGEMENT=y
```

## boards/st/stm32h747i_disco/board.yml
```yaml
board:
  name: stm32h747i_disco
  full_name: STM32H747I Discovery
  vendor: st
  revision:
    format: letter
    default: "O"
    exact: true
    revisions:
      # "V"anilla (no Clock Management)
      - name: "V"
      # "L"ightweight (Clock Management + STM32 drivers + OFF_ON)
      - name: "L"
  socs:
    - name: stm32h747xx
```

## boards/st/stm32h747i_disco/stm32h747i_disco_stm32h747xx_m7_L_defconfig
```kconfig
# SPDX-License-Identifier: Apache-2.0
# Copyright (c) 2025 STMicroelectronics

CONFIG_CLOCK_CONTROL=n
CONFIG_CLOCK_MANAGEMENT=y
CONFIG_CLOCK_MANAGEMENT_DIRECT_STATES=y
CONFIG_CLOCK_MANAGEMENT_NOFREQ_STATES=y
CONFIG_CLOCK_MANAGEMENT_OFF_ON_SUPPORT=y

# Enable the internal SMPS regulator
CONFIG_POWER_SUPPLY_DIRECT_SMPS=y

# Enable GPIO
CONFIG_GPIO=y

# Enable MPU
CONFIG_ARM_MPU=y

# Enable HW stack protection
CONFIG_HW_STACK_PROTECTION=y

# Disable following to assign serial ports to m4 core

# Enable uart driver
CONFIG_SERIAL=y
# Console
CONFIG_CONSOLE=y
CONFIG_UART_CONSOLE=y
```

## drivers/clock_management/Kconfig
```kconfig
# Copyright 2024 NXP
# SPDX-License-Identifier: Apache-2.0

#
# Clock controller drivers
#
menuconfig CLOCK_MANAGEMENT
	bool "Clock management drivers"
	help
	  Enable support for clock management drivers. These drivers provide
	  clock configuration to the system via a series of setpoints, which
	  allow drivers to configure clocks based on their desired power
	  state

if CLOCK_MANAGEMENT

module = CLOCK_MANAGEMENT
module-str = clock management
source "subsys/logging/Kconfig.template.log_config"

config CLOCK_MANAGEMENT_DIRECT_STATES
	bool "Reference states directly"
	help
	  Provide raw pointer to state objects to API consumers
	  instead of using clock_output_data as middleman. This
	  should save 12 bytes per clock-output but breaks
	  RUNTIME and clock_management_req_rate().

config CLOCK_MANAGEMENT_NOFREQ_STATES
	bool "Don't store frequency in clock states"
	help
	  Don't store the clock-frequency DT property from clock-states
	  into their runtime-accessible objects. This saves some space
	  but the return value of clock_management_apply_state() becomes
	  meaningless, clock_management_req_rate() will not work and
	  RUNTIME will be broken.

# because we don't have clock_output objects
# when this is enabled, SET_RATE and RUNTIME
# are not supported
if !CLOCK_MANAGEMENT_DIRECT_STATES && !CLOCK_MANAGEMENT_NOFREQ_STATES

config CLOCK_MANAGEMENT_SET_RATE
	bool "Support runtime rate setting"
	select CLOCK_MANAGEMENT_RUNTIME
	help
	  Allow clock consumers to request a given clock frequency via the
	  clock management framework. The framework will then configure the
	  clock tree so that the consumer is supplied with the closest
	  possible frequency to its request. Note that enabling this feature
	  will result in increased flash utilization

config CLOCK_MANAGEMENT_RUNTIME
	bool "Support runtime clock rate requests"
	help
	  Support runtime clock rate requests. When enabled, clock producers
	  will track the clock requests from each consumer, and reject
	  conflicting requests. This Kconfig also enables registering
	  for clock rate change notifications

endif # CLOCK_MANAGEMENT_DIRECT_STATES

config CLOCK_MANAGEMENT_CLK_NAME
	bool "Store names of each clock"
	help
	  Store names of each clock node. Uses additional ROM space. If
	  clock framework debug logging is enabled, traces will be printed
	  as the clock tree is reconfigured.

config CLOCK_MANAGEMENT_FIXED_SOURCE
	bool "Fixed clock source driver"
	default y
	depends on DT_HAS_FIXED_CLOCK_ENABLED
	help
	  Fixed clock source driver, for non configurable clock sources

config CLOCK_MANAGEMENT_SOURCE
	bool "Clock source driver"
	default y
	depends on DT_HAS_CLOCK_SOURCE_ENABLED
	help
	  Clock source driver, for fixed clock sources that may be gated/ungated

rsource "generic/Kconfig"
source "drivers/clock_management/nxp_syscon/Kconfig"
rsource "stm32/Kconfig"

module = CLOCK_MANAGEMENT
module-str = clock-management
source "subsys/logging/Kconfig.template.log_config"

endif # CLOCK_MANAGEMENT
```

## drivers/clock_management/generic/Kconfig
```kconfig
# Copyright 2025 STMicroelectronics
# SPDX-License-Identifier: Apache-2.0

#
# Generic drivers for common clock tree elements
#

config CLOCK_MANAGEMENT_GENERIC_DRIVERS_READ_AFTER_WRITE
	bool "Read back values after write"
	default y
	help
	  Controls whether or not the generic clock management
	  drivers will read back MMIO registers after writing
	  to them. This is recommended or mandatory on certain
	  platforms to ensure that clock configurations have
	  been applied properly before returning.

config CLOCK_MANAGEMENT_GATE
	bool "Clock gate driver"
	default y
	depends on DT_HAS_CLOCK_GATE_ENABLED
	help
	  Driver for generic clock gates

config CLOCK_MANAGEMENT_MUX
	bool "Clock multiplexer driver"
	default y
	depends on DT_HAS_CLOCK_MUX_ENABLED
	help
	  Driver for generic clock multiplexers
```

## drivers/clock_management/stm32/Kconfig
```kconfig
# Copyright 2025 STMicroelectronics
# SPDX-License-Identifier: Apache-2.0

if SOC_FAMILY_STM32

config CLOCK_MANAGEMENT_STM32
	bool
	default y
	select USE_STM32_LL_UTILS
	help
	  Hidden symbol to enable common clock management code for STM32 family.

config CLOCK_MANAGEMENT_STM32_INLINE
	bool "Inline STM32 register accessors"
	default n
	help
	  Controls whether the STM32 register accessors are inlined in all drivers,
	  or implemented as functions in a single file called by other drivers.

config CLOCK_MANAGEMENT_STM32_BUS_PRESCALER
	bool "STM32 bus prescaler driver"
	default y
	depends on DT_HAS_ST_STM32_BUS_PRESCALER_ENABLED
	help
	  Driver for STM32 bus clock prescalers

config CLOCK_MANAGEMENT_STM32_CLOCK_GATE
	bool "STM32 clock gate"
	default y
	depends on DT_HAS_ST_STM32_CLOCK_GATE_ENABLED
	help
	  Driver for STM32 clock gates

config CLOCK_MANAGEMENT_STM32_CLOCK_GENERATOR
	bool "STM32 internal clock generator"
	default y
	depends on DT_HAS_ST_STM32_CLOCK_GENERATOR_ENABLED
	help
	  Driver for STM32 internal clock generators

config CLOCK_MANAGEMENT_STM32_CLOCK_MULTIPLEXER
	bool "STM32 clock multiplexer"
	default y
	depends on DT_HAS_ST_STM32_CLOCK_MULTIPLEXER_ENABLED
	help
	  Driver for STM32 clock multiplexers

config CLOCK_MANAGEMENT_STM32_INTERNAL_CLKGEN
	bool "STM32 internal clock generators driver"
	default y
	depends on DT_HAS_ST_STM32_INTERNAL_CLKGEN_ENABLED
	help
	  Driver for STM32 clock generators

	  This driver supports HSE, HSI, LSE and LSI.

config CLOCK_MANAGEMENT_STM32_SYSCLK_PRESCALER
	bool "STM32 SYSCLK prescaler driver"
	default y
	depends on DT_HAS_ST_STM32_SYSCLK_PRESCALER_ENABLED
	help
	  Driver for STM32 SYSCLK prescaler

config CLOCK_MANAGEMENT_STM32_TIMER_FREQMUL
	bool "STM32 timer frequency multiplier driver"
	default y
	depends on DT_HAS_ST_STM32_TIMER_FREQMUL_ENABLED
	help
	  Driver for STM32 timer frequency multiplier

config CLOCK_MANAGEMENT_STM32C0_HSISYS_DIV
	bool "STM32C0 HSISYS divider driver"
	default y
	depends on DT_HAS_ST_STM32C0_HSISYS_DIV_ENABLED
	help
	  Driver for STM32C0 HSISYS divider

endif # SOC_FAMILY_STM32
```

## drivers/mdio/Kconfig.stm32
```kconfig
# Copyright (c) 2025 STMicroelectronics
# SPDX-License-Identifier: Apache-2.0

config MDIO_ETHBULITIN_STM32
	bool
	default y
	depends on ETH_STM32_HAL
	depends on DT_HAS_ST_STM32_ETHERNET_MDIO_ENABLED
	select PINCTRL
	help
	  Enable support for the MDIO controller built inside the STM32 Ethernet IP.

	  Since this MDIO controller is dedicated for usage by the STM32 Ethernet IP,
	  the symbol is hidden as this prevents it from being manually enabled.
```

## dts/bindings/clock-management/clock-node.yaml
```yaml
# Copyright 2024 NXP
# SPDX-License-Identifier: Apache-2.0

# Common fields for nodes within clock controller tree

include: base.yaml

properties:
  # TODO: this property should be split out to a new binding
  # (e.g., "static-initable-clock-node")
  #
  # this way, we can guarantee at binding level that one does
  # not attempt to static-init a node which doesn't support it
  "zephyr,cms-static-init":
    type: boolean
    description: |
      Clock node is initialized statically during boot.

  "zephyr,cms-static-disable-at-boot":
    type: boolean
    description: |
      During static initialization at boot, disable this device
      instead of enabling it (via a call to clock_management_off()).

      This property is ignored if "zephyr,cms-static-init" is not set.

  "zephyr,reparent-on-disabled":
    type: boolean
    description: |
      If this node is disabled (status = "disabled"), children nodes
      requesting for their parent (=this node) are redirected to
      this node's parent, effectively skipping this node in the
      clock tree hierarchy.

      This can be used on devices for which the HW default configuration
      is never changed to save space, as it evicts a struct clk_hw from
      the final binary (this may also reduce stack usage and will slightly
      speed up calls to get_rate()).

      WARNING: USE THIS PROPERTY ONLY ON NODES WHERE Fout = Fin.
      USING THIS PROPERTY ON A NODE WHICH MODIFIES FREQUENCY WILL BREAK
      CLOCK RATE CALCULATIONS FOR THE DEVICE AND ALL ITS CHILDREN!!!

  "#clock-cells":
    type: int
    required: true
    description: Number of items to expect in a node setpoint specifier
```

## dts/bindings/clock-management/generic/clock-gate.yaml
```yaml
# Copyright 2025 STMicroelectronics
# SPDX-License-Identifier: Apache-2.0

description: Generic clock gate (single-bit control)

compatible: "clock-gate"

include: [clock-node.yaml]

properties:
  reg:
    required: true
    description: |
      Address cell: register address
      Size cell:    ignored (should be 1)

  gate-offset:
    type: int
    required: true
    description: Gate bit offset in register

  "#clock-cells":
    const: 1

clock-cells:
  - gate_enable
```

## dts/bindings/clock-management/generic/clock-mux.yaml
```yaml
# Copyright 2025 STMicroelectronics
# SPDX-License-Identifier: Apache-2.0

description: Generic clock multiplexer

compatible: "clock-mux"

include: [clock-node.yaml]

properties:
  reg:
    required: true
    description: |
      Address cell: register address
      Size cell:    mux field size (in bits)

  mux-offset:
    type: int
    required: true
    description: Offset of mux field in register

  inputs:
    type: phandles
    required: true
    description: |
      Multiplexer inputs

      The index in this array corresponds to the value that must be programmed
      in the mux register field to select the source found at that index.

      For example, with `inputs = <&clk_a &no_clock &clk_b &clk_c>;`:
        * a value of 0 selects `clk_a`
        * a value of 1 selects no clock
        * a value of 2 selects `clk_b`
        * a value of 3 selects `clk_c`
  "#clock-cells":
    const: 1

clock-cells:
  - input_selection
```

## dts/bindings/clock-management/generic/fixed-prescaler.yaml
```yaml
# Copyright 2025 STMicroelectronics
# SPDX-License-Identifier: Apache-2.0

description: |
  Generic always-on clock prescaler with fixed factor

compatible: "fixed-prescaler"

include:
  - name: clock-node.yaml
    property-blocklist:
      - reg

properties:
  division-factor:
    type: int
    required: true
    description: Division factor between input and output clock

  "#clock-cells":
    const: 0
```

## dts/bindings/clock-management/generic/pow2-prescaler.yaml
```yaml
# Copyright 2025 STMicroelectronics
# SPDX-License-Identifier: Apache-2.0

description: |
  Generic always-on clock prescaler, with configurable power-of-2 division factor

compatible: "pow2-prescaler"

include: [clock-node.yaml]

properties:
  reg:
    required: true
    description: |
      Address cell: register address
      Size cell:    size of the configuration field (number of bits)

  field-offset:
    type: int
    required: true
    description: |
      Offset of the configuration field in register (LSB index)

  "#clock-cells":
    const: 1

clock-cells:
  # Must be a power of 2
  - prescaler
```

## dts/bindings/clock-management/stm32/pll/st,stm32-h7-pll-output.yaml
```yaml
# Copyright 2025 STMicroelectronics
# SPDX-License-Identifier: Apache-2.0

description: |
  STM32H7 PLL output

  See st,stm32-h7-pll-pvco for more details.

  The "reg-XXX" properties are expected to
  be an array of three elements:
    [0]: RCC register address
    [1]: offset of configuration field
    [2]: size of configuration field (defaults to 1 if not present)

compatible: "st,stm32-h7-pll-output"

include: [clock-node.yaml]

properties:
  reg-en:
    type: array
    required: true
    description: DIVyxEN bit location (y = P/Q/R)

  reg-div:
    type: array
    required: true
    description: PLL DIVyx field location (y = P/Q/R)

  "#clock-cells":
    type: int
    const: 1

# static configuration
  div:
    type: int

clock-cells:
  - div
```
